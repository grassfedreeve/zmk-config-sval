## config/west.yml
```yaml
manifest:
  remotes:
    - name: zmkfirmware
      url-base: https://github.com/zmkfirmware
    - name: grassfedreeve
      url-base: https://github.com/grassfedreeve
  projects:
    - name: zmk
      remote: zmkfirmware
      revision: main
      import: app/west.yml
    - name: svalboard-zmk-module
      remote: grassfedreeve
      revision: main
    - name: zmk-driver-pmw3389
      remote: grassfedreeve
      revision: main            
  self:
    path: config
```
